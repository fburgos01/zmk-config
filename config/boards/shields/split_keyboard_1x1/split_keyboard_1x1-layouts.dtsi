// See https://zmk.dev/docs/development/hardware-integration/physical-layouts
// for how to configure this.

#include <physical_layouts.dtsi>

/ {
    layouts {
        physical_layout0: physical_layout_0 {
            compatible = "zmk,physical-layout-grid";
            display-name = "Default Layout";

            matrix-columns = <2>;
            matrix-rows = <1>;

            keys = <
                &key_physical_attrs 100 100 0 0 0 0 0
                &key_physical_attrs 100 100 100 0 0 0 0
            >;
        };
    };
};
