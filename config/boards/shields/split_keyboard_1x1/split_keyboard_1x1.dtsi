// This file was generated from a template. Edit it to match your keyboard.
// See https://zmk.dev/docs/development/hardware-integration/new-shield for more
// instructions.

#include <dt-bindings/zmk/matrix_transform.h>
#include "split_keyboard_1x1-layouts.dtsi"

/ {
    chosen {
        zmk,kscan = &kscan0;
        zmk,matrix-transform = &default_transform;
        zmk,physical-layout = &physical_layout0;
    };

    default_transform: keymap_transform_0 {
        compatible = "zmk,matrix-transform";
        columns = <2>;
        rows = <1>;
        // Mapea la fila 0, col 0 al lado izquierdo, y la fila 0, col 1 al lado derecho
        map = <
            RC(0,0) RC(0,1)
        >;
    };
    kscan0: kscan {
        compatible = "zmk,kscan-gpio-matrix";
        wakeup-source;
        diode-direction = "col2row";
        
        col-gpios = <&gpio0 17 (GPIO_ACTIVE_HIGH | GPIO_PULL_DOWN)>;
        row-gpios = <&gpio0 20 GPIO_ACTIVE_HIGH>;
    };

//    kscan0: kscan {
//        compatible = "zmk,kscan-gpio-matrix";
//        diode-direction = "col2row";
//       
//        col-gpios = <&pro_micro 4 GPIO_ACTIVE_HIGH>;
//        row-gpios = <&pro_micro 5 (GPIO_ACTIVE_HIGH | GPIO_PULL_DOWN)>;
//    };
};
