## config/boards/shields/shw48p48/Kconfig.defconfig
```kconfig
if SHIELD_SHW48P48_LEFT

config ZMK_KEYBOARD_NAME
    default "SHW48+48 Left"

config ZMK_SPLIT_ROLE_CENTRAL
    default y

endif

if SHIELD_SHW48P48_RIGHT

config ZMK_KEYBOARD_NAME
    default "SHW48+48 Right"

config ZMK_SPLIT_ROLE_CENTRAL
    default n

endif

if SHIELD_SHW48P48_LEFT || SHIELD_SHW48P48_RIGHT

config ZMK_SPLIT
    default y

endif
```

## config/boards/shields/shw48p48/Kconfig.shield
```kconfig
config SHIELD_SHW48P48_LEFT
    def_bool $(shields_list_contains,shw48p48_left)

config SHIELD_SHW48P48_RIGHT
    def_bool $(shields_list_contains,shw48p48_right)
```

## config/boards/shields/split_keyboard_1x1/Kconfig.shield
```kconfig
config SHIELD_SPLIT_KEYBOARD_1X1_LEFT
    def_bool $(shields_list_contains,split_keyboard_1x1_left)

config SHIELD_SPLIT_KEYBOARD_1X1_RIGHT
    def_bool $(shields_list_contains,split_keyboard_1x1_right)
```
