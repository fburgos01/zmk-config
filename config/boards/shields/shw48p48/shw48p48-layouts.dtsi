#include <physical_layouts.dtsi>

/ {
    layouts {
        physical_layout0: physical_layout_0 {
            compatible = "zmk,physical-layout-grid";
            display-name = "Default Layout";
            matrix-columns = <16>;
            matrix-rows = <6>;
            keys = <>;
        };
    };
};
